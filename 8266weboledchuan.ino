//CODE DO NHIP TIM HIEN THI LEN OLED VA WEB
#include <SPI.h>
#include <Wire.h>
#include <ESP8266WiFi.h>
#include <ESP8266WebServer.h>
#include <WebSocketsServer.h>
#include <Adafruit_GFX.h>
#include <Adafruit_SSD1306.h>
//----------------------------------------
const char* ssid = "******";
const char* password = "*******";
//----------------------------------------
ESP8266WebServer server(80);
WebSocketsServer webSocket = WebSocketsServer(81);
//----------------------------------------
#define SCREEN_WIDTH 128 
#define SCREEN_HEIGHT 64 
//----------------------------------------

//----------------------------------------
#define OLED_RESET     -1 
Adafruit_SSD1306 display(SCREEN_WIDTH, SCREEN_HEIGHT, &Wire, OLED_RESET);
//----------------------------------------
const char* webpage = R"rawliteral(
<!DOCTYPE html>
<html>
<head>
  <title>Heart Rate Stream</title>
  <script src="https://cdn.jsdelivr.net/npm/chart.js"></script>
</head>
<body>
  <h2>Heart Beat Live Stream</h2>
  <canvas id="chart" width="400" height="150"></canvas>
  <script>
    const ws = new WebSocket("ws://" + location.hostname + ":81/");
    const ctx = document.getElementById("chart").getContext("2d");
    const chart = new Chart(ctx, {
      type: "line",
      data: {
        labels: [],
        datasets: [{
          label: "Pulse Signal",
          data: [],
          borderColor: "red",
          fill: false,
        }]
      },
      options: {
        animation: false,
        responsive: true,
        scales: {
          x: { display: false },
          y: { min: 200, max: 350 }
        }
      }
    });

    ws.onmessage = function(event) {
      const signal = parseInt(event.data);
      const labels = chart.data.labels;
      const data = chart.data.datasets[0].data;

      if (labels.length > 100) {
        labels.shift();
        data.shift();
      }

      labels.push('');
      data.push(signal);
      chart.update();
    };
  </script>
</body>
</html>
)rawliteral";
//----------------------------------------
void webSocketEvent(uint8_t num, WStype_t type, uint8_t * payload, size_t length) {
}
//----------------------------------------
unsigned long previousMillisGetHR = 0; 
unsigned long previousMillisResultHR = 0;

const long intervalGetHR = 20; 
const long intervalResultHR = 10000; 

int PulseSensorSignal; 
const int PulseSensorHRWire = A0;
const int LED_A1 = 13; 
int UpperThreshold = 285; 
int LowerThreshold = 270; 

int cntHB = 0; 
boolean ThresholdStat = true; 
int BPMval = 0; 

int x=0; 
int y=0; 
int lastx=0; 
int lasty=0; 
//----------------------------------------

//----------------------------------------
const unsigned char LogoChannel [] PROGMEM = {
	0x00, 0x00, 0x00, 0x00, 0x00, 0x00, 0x00, 0x00, 0x00, 0x00, 0x00, 0x00, 0x00, 0x00, 0x00, 0x00,
0x00, 0x00, 0x00, 0x00, 0x00, 0x00, 0x00, 0x00, 0x00, 0x00, 0x00, 0x00, 0x00, 0x00, 0x00, 0x00,
0x00, 0x00, 0x00, 0x00, 0x00, 0x00, 0x00, 0x00, 0x00, 0x00, 0x00, 0x00, 0x00, 0x00, 0x00, 0x00,
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0x00, 0x00, 0x00, 0x00, 0x00, 0x00, 0x00, 0x00, 0x00, 0x00, 0x00, 0x00, 0x00, 0x00, 0x00, 0x00
};
//----------------------------------------

//----------------------------------------'Heart_Icon', 16x16px

const unsigned char Heart_Icon [] PROGMEM = {
  0x00, 0x00, 0x18, 0x30, 0x3c, 0x78, 0x7e, 0xfc, 0xff, 0xfe, 0xff, 0xfe, 0xee, 0xee, 0xd5, 0x56, 
  0x7b, 0xbc, 0x3f, 0xf8, 0x1f, 0xf0, 0x0f, 0xe0, 0x07, 0xc0, 0x03, 0x80, 0x01, 0x00, 0x00, 0x00
};
//----------------------------------------

//--------------------------------------------------------------------------------void setup
void setup() {
  pinMode(LED_A1,OUTPUT); //--> Set LED_3 PIN as Output.
  Serial.begin(9600); //--> Set's up Serial Communication at certain speed.
  Serial.begin(115200);
  WiFi.begin(ssid, password);
  while (WiFi.status() != WL_CONNECTED) delay(500);
  //----------------------------------------
  Serial.println("WiFi connected: ");
  Serial.println(WiFi.localIP());
  delay(5000);
  //----------------------------------------SSD1306_SWITCHCAPVCC = generate display voltage from 3.3V internally
  // Address 0x3C for 128x32 and Address 0x3D for 128x64.
  // But on my 128x64 module the 0x3D address doesn't work. What works is the 0x3C address.
  // So please try which address works on your module.
  if(!display.begin(SSD1306_SWITCHCAPVCC, 0x3C)) { 
    Serial.println(F("SSD1306 allocation failed"));
    for(;;); //--> Don't proceed, loop forever
  }
  //----------------------------------------
  server.on("/", []() {
    server.send(200, "text/html", webpage);  // 🔺 Lúc này biến đã được định nghĩa trước
  });

  //----------------------------------------Show initial display buffer contents on the screen
  // the library initializes this with an Adafruit splash screen.
  display.display();
  delay(1000);
  //----------------------------------------
  
  //----------------------------------------Display Bitmap Images
  display.clearDisplay(); //--> for Clearing the display
  display.drawBitmap(0, 0, LogoChannel, 128, 64, WHITE); //--> display.drawBitmap(x position, y position, bitmap data, bitmap width, bitmap height, color)
  display.display();
  delay(2000); // Pause for 3 seconds
  //----------------------------------------
  
  //----------------------------------------Displays BPM value reading information
  display.clearDisplay();
  display.setTextSize(1);
  display.setTextColor(WHITE);
  
  display.setCursor(0, 12); //--> (x position, y position)
  display.print("     Please wait");
  
  display.setCursor(0, 22); //--> (x position, y position)
  display.print("     10  seconds");
  
  display.setCursor(0, 32); //--> (x position, y position)
  display.print("       to get");
  
  display.setCursor(0, 42); //--> (x position, y position)
  display.print(" the Heart Rate value");
  
  display.display(); 
  delay(3000);
  //----------------------------------------
  
  //----------------------------------------Displays the initial display of BPM value
  display.clearDisplay(); //--> for Clearing the display
  display.drawBitmap(0, 47, Heart_Icon, 16, 16, WHITE); //--> display.drawBitmap(x position, y position, bitmap data, bitmap width, bitmap height, color)
  
  display.drawLine(0, 43, 127, 43, WHITE); //--> drawLine(x1, y1, x2, y2, color)
  
  display.setTextSize(2);
  display.setTextColor(WHITE);
  display.setCursor(20, 48); //--> (x position, y position)
  display.print(": 0 BPM");
  display.display(); 
  //----------------------------------------
  
  Serial.println();
  Serial.println("Please wait 10 seconds to get the BPM Value");
//--------------------------------------------------------------------------------
  server.begin();
  webSocket.begin();
  webSocket.onEvent(webSocketEvent);
//--------------------------------------------------------------------------------void loop
}
void loop() {
  GetHeartRate(); //--> Calling the GetHeartRate() subroutine
//--------------------------------------------------------------------------------
  server.handleClient();
  webSocket.loop();
  int signal = analogRead(PulseSensorHRWire);
  String data = String(signal);
  webSocket.broadcastTXT(data);
  Serial.println(signal);
  delay(20); // Có thể điều chỉnh cho mượt hơn
}
//--------------------------------------------------------------------------------void GetHeartRate()
// This subroutine is for reading the heart rate and calculating it to get the BPM value.
// To get a BPM value based on a heart rate reading for 10 seconds.
void GetHeartRate() {
  //----------------------------------------Process of reading heart rate.
  unsigned long currentMillisGetHR = millis();

  if (currentMillisGetHR - previousMillisGetHR >= intervalGetHR) {
    previousMillisGetHR = currentMillisGetHR;

    PulseSensorSignal = analogRead(PulseSensorHRWire); //--> holds the incoming raw data. Signal value can range from 0-1024

    if (PulseSensorSignal > UpperThreshold && ThresholdStat == true) {
      cntHB++;
      ThresholdStat = false;
      digitalWrite(LED_A1,HIGH);
    }

    if (PulseSensorSignal < LowerThreshold) {
      ThresholdStat = true;
      digitalWrite(LED_A1,LOW);
    }
    
    DrawGraph(); //--> Calling the DrawGraph() subroutine
  }
  //----------------------------------------

  //----------------------------------------The process for getting the BPM value.
  unsigned long currentMillisResultHR = millis();

  if (currentMillisResultHR - previousMillisResultHR >= intervalResultHR) {
    previousMillisResultHR = currentMillisResultHR;

    BPMval = cntHB * 6; //--> The taken heart rate is for 10 seconds. So to get the BPM value, the total heart rate in 10 seconds x 6.
    Serial.print("BPM : ");
    Serial.println(BPMval);
    
    display.fillRect(20, 48, 108, 18, BLACK);
    
    display.drawBitmap(0, 47, Heart_Icon, 16, 16, WHITE); //--> display.drawBitmap(x position, y position, bitmap data, bitmap width, bitmap height, color)   
    display.drawLine(0, 43, 127, 43, WHITE); //--> drawLine(x1, y1, x2, y2, color)
  
    display.setTextSize(2);
    display.setTextColor(WHITE);
    display.setCursor(20, 48); //--> (x position, y position)
    display.print(": ");
    display.print(BPMval);
    display.print(" BPM");
    display.display(); 
    
    cntHB = 0;
  }
  //----------------------------------------
}
//--------------------------------------------------------------------------------

//--------------------------------------------------------------------------------Subroutines for drawing or displaying heart rate graphic signals
void DrawGraph() {
  //----------------------------------------Condition to reset the graphic display if it fills the width of the OLED screen
  if (x > 127) {
    display.fillRect(0, 0, 128, 42, BLACK);
    x = 0;
    lastx = 0;
  }
  //----------------------------------------

  //----------------------------------------Process signal data to be displayed on OLED in graphic form
  int ySignal = PulseSensorSignal; 
  
  if (ySignal > 550) ySignal = 550;
  if (ySignal < 50) ySignal = 50;

  int ySignalMap = map(ySignal, 50, 650, 0, 40); //--> The y-axis used on OLEDs is from 0 to 40
  
  y = 40 - ySignalMap;
  //----------------------------------------

  //----------------------------------------Displays the heart rate graph
  display.writeLine(lastx,lasty,x,y,WHITE);
  display.display(); 
  //----------------------------------------
  
  lastx = x;
  lasty = y;
  
  x++;
}